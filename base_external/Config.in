## base_external/Config.in
```kconfig
source "$BR2_EXTERNAL_project_base_PATH/package/vending_machine/Config.in"
source "$BR2_EXTERNAL_project_base_PATH/package/hardware_integration/Config.in"
```

## base_external/package/hardware_integration/Config.in
```kconfig
config BR2_PACKAGE_HARDWARE_INTEGRATION
	bool "hardware-integration"
	help
	  Hardware integration package.
```

## base_external/package/vending_machine/Config.in
```kconfig
config BR2_PACKAGE_VENDING_MACHINE
	bool "vending-machine"
	help
	  Core vending machine package.
```
